## base_external/Config.in
```kconfig
source "$BR2_EXTERNAL_project_base_PATH/package/ws2812/Config.in"
source "$BR2_EXTERNAL_project_base_PATH/package/platform_driver_test/Config.in"
```

## base_external/package/platform_driver_test/Config.in
```kconfig
config BR2_PACKAGE_PLATFORM_DRIVER_TEST
	bool "platform_driver_test"
	help
		A platform driver test
```

## base_external/package/ws2812/Config.in
```kconfig
config BR2_PACKAGE_WS2812
	bool "ws2812"
	help
		A kernel driver for WS2812 LED strips
```
